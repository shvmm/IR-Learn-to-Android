## ir-firmware-esp32s3-gpio9/main/Kconfig.projbuild
```kconfig
menu "IR Code Studio"
    config IR_RX_GPIO
        int "IR receiver output GPIO (check your board wiring)"
        range 0 48
        default 9
    config IR_ACTIVE_LOW
        bool "Receiver output is active low (typical demodulating receiver)"
        default y
    config IR_IDLE_US
        int "End a frame after this long without an edge (microseconds)"
        range 10000 30000
        default 15000
endmenu
```

## ir-firmware-esp32s3-gpio9/sdkconfig.defaults
```kconfig
CONFIG_IDF_TARGET="esp32s3"
CONFIG_ESP_CONSOLE_USB_SERIAL_JTAG=y
CONFIG_ESP_CONSOLE_UART_BAUDRATE=115200
CONFIG_LOG_DEFAULT_LEVEL_WARN=y
CONFIG_IR_RX_GPIO=9
CONFIG_IR_ACTIVE_LOW=y
CONFIG_IR_IDLE_US=15000
```
